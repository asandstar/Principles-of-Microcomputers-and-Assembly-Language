/*
1、确保直流电机的B接VCC，利用任一I/O口，以及拨盘开关或按键，
输出占空比分别为20%、40%、60%、80%的PWM给直流电机的A端，
实现直流电机转速的调节,并用示波器观察输出波形与实际转速的关系，
PWM需用2个定时器产生，频率自定，电机须运转稳定。
*/
PWM8BIT EQU 256
HIGHDUTY EQU 64
LOWDUTY EQU (PWM8BIT-HIGHDUTY)
AUXR DATA 08EH
INT_CLKO DATA 08FH
T0CLKO BIT P3.5
FLAG BIT 20H.0
ORG 0000H
LJMP MAIN

ORG 000BH
LJMP TM0_ISR

MAIN:
	MOV AUXR, #80H
	MOV INT_CLKO,#01H
	ANL TMOD,#0F0H
	MOV TL0, #LOW(65536-LOWDUTY)
	MOV TH0, #HIGH(65536-LOWDUTY)
	SETB T0CLKO
	CLR FLAG
	SETB TR0
	SETB ET0
	SETB EA
	SJMP $

TM0_ISR:
	CPL FLAG
	JNB FLAG, READYLOW
READYHIGH:
	MOV TL0, #LOW(65536-HIGHDUTY)
	MOV TH0, #LOW(65536-HIGHDUTY)
	JMP TM0ISR_EXIT
READYLOW:
	MOV TL0, #LOW(65536-LOWDUTY)
	MOV TH0, #HIGH(65536-LOWDUTY)
TM0ISR_EXIT:
	RETI

	END