	ORG 0000H
	LJMP MAIN
	ORG 0003H
	LJMP INTT0
	ORG 0013H
	LJMP INTT1

	ORG 0100H
MAIN: 
	SETB P1.0 ;PWM输出端口
	CLR P1.6;清零INTT0 溢出标志
	SETB P1.7;设置INTT1 溢出标志	
	MOV TMOD,#11H;定时器T0，T1,模式1
	SETB EA;CPU 开放中断
	SETB IT0;边沿触发
	SETB IT1
	SETB EX0;允许外部中断
	SETB EX1
	MOV R0,#0F1H ;R0,R1 保存高电平维持时间
	MOV R1,#09AH
	MOV R2,#0C6H;R2,R3 保存低电平维持时间
	MOV R3,#66H//62+B9=1 3A	
	MOV TH0,R0
	MOV TL0,R1
	MOV TH1,R2
	MOV TL1,R3
START: 
	SETB TR0	
LOOP: 
	JBC TF0,NEXT0;溢出标志位为1 则跳出循环
	SJMP LOOP
NEXT0: 
	CPL P1.0;翻转P1.0
	CLR TR0
	JB P1.0,UP0;若P1.0 为高电平,则进入高电平时间赋值
	MOV TH0,R2
	MOV TL0,R3
	SJMP BACK
UP0: 
	MOV TH0,R0
	MOV TL0,R1
BACK: 
	SJMP START

	ORG 0200H
INTT0: 
	ACALL DELAY50MS
	CLR P1.7;清零INTT1 溢出位
	JB P1.6,FAIL0;如果INTT0 溢出位为1,功能失效
	ACALL DUTY40
	SETB P1.6;若A 为00H 则表明INTT0溢出,设置溢出位
FAIL0: 
	CLR IE0;关闭中断
	RETI

	ORG 0300H
INTT1: 
	ACALL DELAY50MS
	CLR P1.6;清零INTT0 溢出位
	JB P1.7,FAIL1;如果INTT1 溢出位为一,功能失效
	ACALL DUTY20
	SETB P1.7;若A 为00H 则表明INTT1 溢出,置溢出位
FAIL1: 
	CLR IE1;关闭中断
	RETI
DELAY50MS:			;@11.0592MHz
	NOP
	NOP
	NOP
	PUSH	30H
	PUSH	31H
	PUSH	32H
	MOV		30H,#2
	MOV		31H,#175
	MOV		32H,#72
NEXT50:
	DJNZ	32H,NEXT50
	DJNZ	31H,NEXT50
	DJNZ	30H,NEXT50
	POP		32H
	POP		31H
	POP		30H
	RET
DUTY40:
	MOV R0,#0E3H ;R0,R1 保存高电平维持时间
	MOV R1,#33H
	MOV R2,#0D4H;R2,R3 保存低电平维持时间
	MOV R3,#0CCH//62+B9=1 3A
	RET
DUTY20:
	MOV R0,#0F1H ;R0,R1 保存高电平维持时间
	MOV R1,#09AH
	MOV R2,#0C6H;R2,R3 保存低电平维持时间
	MOV R3,#66H//62+B9=1 3A
	RET	
	SJMP $
	END

/*
	ORG 0000H
	LJMP MAIN
	ORG 0003H
	LJMP INTT0
	ORG 0013H
	LJMP INTT1

	ORG 0100H
MAIN: 
	SETB P1.0 ;PWM输出端口
	CLR P1.6;清零INTT0 溢出标志
	SETB P1.7;设置INTT1 溢出标志	
	MOV TMOD,#11H;定时器T0，T1,模式1
	SETB EA;CPU 开放中断
	SETB IT0;边沿触发
	SETB IT1
	SETB EX0;允许外部中断
	SETB EX1
	MOV R0,#0F1H ;R0,R1 保存高电平维持时间
	MOV R1,#09AH
	MOV R2,#0C6H;R2,R3 保存低电平维持时间
	MOV R3,#66H//62+B9=1 3A	
	MOV TH0,R0
	MOV TL0,R1
//	MOV TH1,R2
//	MOV TL1,R3
	SETB TR0
	SETB TR1
START: 
	SETB TR0	
LOOP: 
	JBC TF0,NEXT0;溢出标志位为1 则跳出循环
	SJMP LOOP
NEXT0: 
	CPL P1.0;翻转P1.0
	CLR TR0
	JB P1.0,UP0;若P1.0 为高电平,则进入高电平时间赋值
	MOV TH0,R2
	MOV TL0,R3
	SJMP BACK
UP0: 
	MOV TH0,R0
	MOV TL0,R1
BACK: 
	SJMP START

	ORG 0200H
INTT0: 
	ACALL DELAY50MS
	CLR P1.7;清零INTT1 溢出位
	JB P1.6,FAIL0;如果INTT0 溢出位为1,功能失效
	ACALL DUTY40
	SETB P1.6;若A 为00H 则表明INTT0溢出,设置溢出位
FAIL0: 
	CLR IE0;关闭中断
	RETI

	ORG 0300H
INTT1: 
	ACALL DELAY50MS
	CLR P1.6;清零INTT0 溢出位
	JB P1.7,FAIL1;如果INTT1 溢出位为一,功能失效
	ACALL DUTY20
	SETB P1.7;若A 为00H 则表明INTT1 溢出,置溢出位
FAIL1: 
	CLR IE1;关闭中断
	RETI
DELAY50MS:			;@11.0592MHz
	NOP
	NOP
	NOP
	PUSH	30H
	PUSH	31H
	PUSH	32H
	MOV		30H,#2
	MOV		31H,#175
	MOV		32H,#72
NEXT50:
	DJNZ	32H,NEXT50
	DJNZ	31H,NEXT50
	DJNZ	30H,NEXT50
	POP		32H
	POP		31H
	POP		30H
	RET
DUTY40:
	MOV R0,#0E3H ;R0,R1 保存高电平维持时间
	MOV R1,#33H
	MOV R2,#0D4H;R2,R3 保存低电平维持时间
	MOV R3,#0CCH//62+B9=1 3A
	RET
DUTY20:
	MOV R0,#0F1H ;R0,R1 保存高电平维持时间
	MOV R1,#09AH
	MOV R2,#0C6H;R2,R3 保存低电平维持时间
	MOV R3,#66H//62+B9=1 3A
	RET	
	SJMP $
	END
*/

/*
	ORG 0000H
	LJMP MAIN
	ORG 0003H
	LJMP INTT0
	ORG 0013H
	LJMP INTT1

	ORG 0100H
MAIN: 
	SETB P1.0 ;PWM输出端口
	CLR P1.6;清零INTT0 溢出标志
	SETB P1.7;设置INTT1 溢出标志	
	MOV TMOD,#11H;定时器T0，T1,模式1
	SETB EA;CPU 开放中断
	SETB IT0;边沿触发
	SETB IT1
	SETB EX0;允许外部中断
	SETB EX1
	MOV R0,#0F1H ;R0,R1 保存高电平维持时间
	MOV R1,#09AH
	MOV R2,#0C6H;R2,R3 保存低电平维持时间
	MOV R3,#66H//62+B9=1 3A	
	MOV TH0,R0
	MOV TL0,R1
//	MOV TH1,R2
//	MOV TL1,R3
	SETB TR0	
LOOP0: 
	JBC TF0,NEXT0;溢出标志位为1 则跳出循环
	SJMP LOOP0

LOOP1:
	JBC TF1,NEXT0


NEXT0: 
	CPL P1.0;翻转P1.0
	JB P1.0,UP0;若P1.0 为高电平,则进入高电平时间赋值
	JNB P1.0,DOWN0;若P1.0 为高电平,则进入高电平时间赋值	
UP0: 
	CLR TR1
	SETB TR0
	MOV TH0,R0
	MOV TL0,R1

DOWN0:
	CLR TR0
	SETB TR1
	MOV TH0,R2
	MOV TL0,R3

	ORG 0200H
INTT0: 
	ACALL DELAY50MS
	ACALL DUTY40
	RETI

	ORG 0300H
INTT1: 
	ACALL DELAY50MS
	ACALL DUTY20
	RETI
DELAY50MS:			;@11.0592MHz
	NOP
	NOP
	NOP
	PUSH	30H
	PUSH	31H
	PUSH	32H
	MOV		30H,#2
	MOV		31H,#175
	MOV		32H,#72
NEXT50:
	DJNZ	32H,NEXT50
	DJNZ	31H,NEXT50
	DJNZ	30H,NEXT50
	POP		32H
	POP		31H
	POP		30H
	RET
DUTY40:
	MOV R0,#0E3H ;R0,R1 保存高电平维持时间
	MOV R1,#33H
	MOV R2,#0D4H;R2,R3 保存低电平维持时间
	MOV R3,#0CCH//62+B9=1 3A
	RET
DUTY20:
	MOV R0,#0F1H ;R0,R1 保存高电平维持时间
	MOV R1,#09AH
	MOV R2,#0C6H;R2,R3 保存低电平维持时间
	MOV R3,#66H//62+B9=1 3A
	RET	
	SJMP $
	END
*/


