//$INCLUDE (STC15F2K60S2.INC) ;包含STC15F2K60S2单片机寄存器定义文件
	ADC_DATA EQU 40H 			;定义A/D转换结果保存单元
	P1ASF EQU 9DH
	ADC_CONTR EQU 0BCH
	ADC_RES EQU 0BDH
	ADC_RESL EQU 0BEH
	ORG 0000H
	LJMP MAIN
	ORG 0100H
MAIN:
;	MOV 40H,#00
	MOV SP,#70H				;设置堆栈
	MOV P1ASF, #80H			;设置P1.7为模拟量输入功能
	MOV ADC_CONTR, #87H		;打开A/D转换电源，设置输入通道
	MOV A, #20H
	LCALL DELAY1MS				;打开A/D转换电源后，延时1ms即可
LOOP:
	MOV ADC_CONTR, #10001111B ;启动A/D转换
	NOP
	NOP
	NOP
	NOP
WAIT_AD:
	MOV A,ADC_CONTR
	JNB ACC.4, WAIT_AD		;判断A/D转换是否完成
	MOV ADC_CONTR, #87H		;将ADC_FLAG清零
	MOV A, ADC_RES			;读取A/D转换结果
	MOV ADC_DATA,A			;保存A/D转换结果
	LJMP LOOP				;循环检测
DELAY1MS:			;@11.0592MHz
	PUSH	30H
	PUSH	31H
	MOV		30H,#9
	MOV		31H,#150
NEXT:
	DJNZ	31H,NEXT
	DJNZ	30H,NEXT
	POP		31H
	POP		30H
	RET


	END


